## build/conf/bblayers.conf
```bitbake
# POKY_BBLAYERS_CONF_VERSION is increased each time build/conf/bblayers.conf
# changes incompatibly
POKY_BBLAYERS_CONF_VERSION = "2"

BBPATH = "${TOPDIR}"
BBFILES ?= ""

BBLAYERS ?= " \
  ${BBPATH}/../poky-nanbield/meta \
  ${BBPATH}/../poky-nanbield/meta-poky \
  ${BBPATH}/../poky-nanbield/meta-openembedded/meta-oe \
  ${BBPATH}/../poky-nanbield/meta-openembedded/meta-python \
  ${BBPATH}/../poky-nanbield/meta-yocto-bsp \
  ${BBPATH}/../poky-nanbield/meta-beagleboard/common-bsp \
  ${BBPATH}/../poky-nanbield/meta-beagleboard/meta-beagleboard-extras \
  ${BBPATH}/../poky-nanbield/meta-linuxcnc \
  "
```

## build/conf/distro/linuxcnc.conf
```bitbake
# Distro Layer configuration
# include and overwrite default poky distro
include conf/distro/poky.conf

DISTRO_VERSION = "0.1.0"
DISTRO_NAME = "LinuxCNC-2.9"
DISTRO_CODENAME = "Guacamole"
SDK_VENDOR = "-lemgo_makers"
SDK_VERSION="${DISTRO_VERSION}"
MAINTAINER = "Joerg@Bernau.family"
# TCLIBC = 

# Override these in poky based distros
LINUXCNC_DEFAULT_DISTRO_FEATURES = "bluetooth ext2 usbgadget usbhost wifi xattr nfs zeroconf 3g qtbase qtquick qtdeclarative"
LINUXCNC_DEFAULT_EXTRA_RDEPENDS = "packagegroup-core-boot"
LINUXCNC_DEFAULT_EXTRA_RRECOMMENDS = "kernel-module-af-packet"

DISTRO_EXTRA_RDEPENDS += " ${MYDISTRO_DEFAULT_EXTRA_RDEPENDS}"
DISTRO_EXTRA_RRECOMMENDS += " ${MYDISTO_DEFAULT_EXTRA_RRECOMMENDS}"

DISTRO_FEATURES ?= "${LINUXCNC_DEFAULT_DISTRO_FEATURES} ${DISTRO_FEATURES_LIBC} systemd "
DISTRO_EXTRA_RDEPENDS = "linuxcnc-layer"
# DISTRO_EXTRA_RRECOMMENDS = 
PACKAGE_CLASSES = "package_deb"
# Use systemd as init manager
DISTRO_FEATURES_BACKFILL_CONSIDERED += "sysvinit"
VIRTUAL-RUNTIME_init_manager = "systemd"
VIRTUAL-RUNTIME_initscripts = "systemd-compat-units"
```

## poky-nanbield/meta-linuxcnc/conf/layer.conf
```bitbake
# We have a conf and classes directory, append to BBPATH
BBPATH .= ":${LAYERDIR}"

# We have a recipes directory, add to BBFILES
BBFILES += "${LAYERDIR}/receipes-*/*.bb ${LAYERDIR}/receipes-*/*.bbappend"

BBFILE_COLLECTIONS += "linuxcnc-layer"
BBFILE_PATTERN_linuxcnc-layer := "^${LAYERDIR}/"
BBFILE_PRIORITY_linuxcnc-layer = "5"

# This should only be incremented on significant changes that will
# cause compatibility issues with other layers
LAYERVERSION_linuxcnc-layer = "1"

LAYERDEPENDS_linuxcnc-layer = "core"
LAYERDEPENDS_linuxcnc-layer += "openembedded-layer"
#LAYERDEPENDS_linuxcnc-layer += "gnome-layer"
#LAYERDEPENDS_linuxcnc-layer += "multimedia-layer"
LAYERDEPENDS_linuxcnc-layer += "meta-python"
LAYERDEPENDS_linuxcnc-layer += "networking-layer"

LAYERSERIES_COMPAT_linuxcnc-layer = "nanbield"

SIGGEN_EXCLUDE_SAFE_RECIPE_DEPS += "\
  openzone->gdk-pixbuf \
  openzone->gtk+3 \
  rodent-icon-theme->gdk-pixbuf \
  rodent-icon-theme->gtk+3 \
"
```
